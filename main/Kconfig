## main/Kconfig
```kconfig
menu "SPL Features"
config FEATURE_INTERFACE_MQTT
    bool "Enable MQTT interface"
    default n

config FEATURE_DEVICE_LIGHT
    bool "Enable light device"
    default n

config LIGHT_COUNT
    int "Number of lights"
    default 1
    range 0 4
    depends on FEATURE_DEVICE_LIGHT

config LIGHT_START_GPIO
    int "First light GPIO"
    default 2
    depends on FEATURE_DEVICE_LIGHT

config FEATURE_DEVICE_RELAY
    bool "Enable relay device"
    default n

config RELAY_COUNT
    int "Number of relays"
    default 1
    range 0 4
    depends on FEATURE_DEVICE_RELAY

config RELAY_START_GPIO
    int "First relay GPIO"
    default 4
    depends on FEATURE_DEVICE_RELAY

config FEATURE_DEVICE_SENSOR
    bool "Enable sensor device"
    default n

config SENSOR_COUNT
    int "Number of sensors"
    default 1
    range 0 4
    depends on FEATURE_DEVICE_SENSOR

config SENSOR_START_GPIO
    int "First sensor GPIO"
    default 5
    depends on FEATURE_DEVICE_SENSOR

config FEATURE_SERVICES_WIFIAP
    bool "Enable WiFi Access Point"
    default n

config FEATURE_SERVICES_SYSTIME
    bool "Enable system time service"
    default n

endmenu
```

## main/Kconfig.projbuild
```kconfig
menu "SmartHome"

menu "Interfaces"

config FEATURE_INTERFACE_CLI
    bool "Enable CLI interface"
    default n

config FEATURE_INTERFACE_MQTT
    bool "Enable MQTT interface"
    default n
    select SERVICES_WIFICLIENT

if FEATURE_INTERFACE_MQTT

menu "Mqtt Configuration"  

config FEATURE_INTERFACE_MQTT_BROKERURI
    string "MQTT Broker URI"
    default "mqtt://192.168.178.65"
    depends on FEATURE_INTERFACE_MQTT

config FEATURE_INTERFACE_MQTT_DEVICEID
    string "MQTT Device ID"
    default "esp32"
    depends on FEATURE_INTERFACE_MQTT

endmenu

endif

endmenu

menu "IO Selection"

choice FEATURE_COMPONENT_GPIO2_FUNCTION
    prompt "GPIO 2 Function (Output Only)"
    default FEATURE_COMPONENT_GPIO2_UNUSED

config FEATURE_COMPONENT_GPIO2_UNUSED
    bool "Unused"

config FEATURE_COMPONENT_GPIO2_OUTPUT_ANALOG
    bool "PWM Output"

config FEATURE_COMPONENT_GPIO2_OUTPUT_BINARY
    bool "Binary Output"

endchoice

choice FEATURE_COMPONENT_GPIO4_FUNCTION
    prompt "GPIO 4 Function"
    default FEATURE_COMPONENT_GPIO4_UNUSED

config FEATURE_COMPONENT_GPIO4_UNUSED
    bool "Unused"

config FEATURE_COMPONENT_GPIO4_OUTPUT_ANALOG
    bool "PWM Output"

config FEATURE_COMPONENT_GPIO4_OUTPUT_BINARY
    bool "Binary Output"

config FEATURE_COMPONENT_GPIO4_INPUT_BINARY
    bool "Binary Input"

endchoice

choice FEATURE_COMPONENT_GPIO4_INPUT_BINARY_PULL
    prompt "GPIO 4 Binary Input Pull Mode"
    default FEATURE_COMPONENT_GPIO4_INPUT_BINARY_PULLUP
    depends on FEATURE_COMPONENT_GPIO4_INPUT_BINARY

config FEATURE_COMPONENT_GPIO4_INPUT_BINARY_PULLUP
    bool "Pull-up"

config FEATURE_COMPONENT_GPIO4_INPUT_BINARY_PULLDOWN
    bool "Pull-down"

config FEATURE_COMPONENT_GPIO4_INPUT_BINARY_FLOATING
    bool "Floating / no pull"

endchoice

choice FEATURE_COMPONENT_GPIO25_FUNCTION
    prompt "GPIO 25 Function"
    default FEATURE_COMPONENT_GPIO25_UNUSED

config FEATURE_COMPONENT_GPIO25_UNUSED
    bool "Unused"

config FEATURE_COMPONENT_GPIO25_OUTPUT_ANALOG
    bool "PWM Output"

config FEATURE_COMPONENT_GPIO25_OUTPUT_BINARY
    bool "Binary Output"

config FEATURE_COMPONENT_GPIO25_INPUT_BINARY
    bool "Binary Input"

endchoice

choice FEATURE_COMPONENT_GPIO25_INPUT_BINARY_PULL
    prompt "GPIO 25 Binary Input Pull Mode"
    default FEATURE_COMPONENT_GPIO25_INPUT_BINARY_PULLUP
    depends on FEATURE_COMPONENT_GPIO25_INPUT_BINARY

config FEATURE_COMPONENT_GPIO25_INPUT_BINARY_PULLUP
    bool "Pull-up"

config FEATURE_COMPONENT_GPIO25_INPUT_BINARY_PULLDOWN
    bool "Pull-down"

config FEATURE_COMPONENT_GPIO25_INPUT_BINARY_FLOATING
    bool "Floating / no pull"

endchoice

choice FEATURE_COMPONENT_GPIO26_FUNCTION
    prompt "GPIO 26 Function"
    default FEATURE_COMPONENT_GPIO26_UNUSED

config FEATURE_COMPONENT_GPIO26_UNUSED
    bool "Unused"

config FEATURE_COMPONENT_GPIO26_OUTPUT_ANALOG
    bool "PWM Output"

config FEATURE_COMPONENT_GPIO26_OUTPUT_BINARY
    bool "Binary Output"

config FEATURE_COMPONENT_GPIO26_INPUT_BINARY
    bool "Binary Input"

endchoice

choice FEATURE_COMPONENT_GPIO26_INPUT_BINARY_PULL
    prompt "GPIO 26 Binary Input Pull Mode"
    default FEATURE_COMPONENT_GPIO26_INPUT_BINARY_PULLUP
    depends on FEATURE_COMPONENT_GPIO26_INPUT_BINARY

config FEATURE_COMPONENT_GPIO26_INPUT_BINARY_PULLUP
    bool "Pull-up"

config FEATURE_COMPONENT_GPIO26_INPUT_BINARY_PULLDOWN
    bool "Pull-down"

config FEATURE_COMPONENT_GPIO26_INPUT_BINARY_FLOATING
    bool "Floating / no pull"

endchoice


choice FEATURE_COMPONENT_GPIO27_FUNCTION
    prompt "GPIO 27 Function"
    default FEATURE_COMPONENT_GPIO27_UNUSED

config FEATURE_COMPONENT_GPIO27_UNUSED
    bool "Unused"

config FEATURE_COMPONENT_GPIO27_OUTPUT_ANALOG
    bool "PWM Output"

config FEATURE_COMPONENT_GPIO27_OUTPUT_BINARY
    bool "Binary Output"

config FEATURE_COMPONENT_GPIO27_INPUT_BINARY
    bool "Binary Input"

endchoice

choice FEATURE_COMPONENT_GPIO27_INPUT_BINARY_PULL
    prompt "GPIO 27 Binary Input Pull Mode"
    default FEATURE_COMPONENT_GPIO27_INPUT_BINARY_PULLUP
    depends on FEATURE_COMPONENT_GPIO27_INPUT_BINARY

config FEATURE_COMPONENT_GPIO27_INPUT_BINARY_PULLUP
    bool "Pull-up"

config FEATURE_COMPONENT_GPIO27_INPUT_BINARY_PULLDOWN
    bool "Pull-down"

config FEATURE_COMPONENT_GPIO27_INPUT_BINARY_FLOATING
    bool "Floating / no pull"

endchoice

choice FEATURE_COMPONENT_GPIO32_FUNCTION
    prompt "GPIO 32 Function (+ADC)"
    default FEATURE_COMPONENT_GPIO32_UNUSED

config FEATURE_COMPONENT_GPIO32_UNUSED
    bool "Unused"

config FEATURE_COMPONENT_GPIO32_OUTPUT_ANALOG
    bool "PWM Output"

config FEATURE_COMPONENT_GPIO32_OUTPUT_BINARY
    bool "Binary Output"

config FEATURE_COMPONENT_GPIO32_INPUT_BINARY
    bool "Binary Input"

config FEATURE_COMPONENT_GPIO32_INPUT_ANALOG
    bool "Analog Input"

endchoice

choice FEATURE_COMPONENT_GPIO32_INPUT_BINARY_PULL
    prompt "GPIO 32 Binary Input Pull Mode"
    default FEATURE_COMPONENT_GPIO32_INPUT_BINARY_PULLUP
    depends on FEATURE_COMPONENT_GPIO32_INPUT_BINARY

config FEATURE_COMPONENT_GPIO32_INPUT_BINARY_PULLUP
    bool "Pull-up"

config FEATURE_COMPONENT_GPIO32_INPUT_BINARY_PULLDOWN
    bool "Pull-down"

config FEATURE_COMPONENT_GPIO32_INPUT_BINARY_FLOATING
    bool "Floating / no pull"

endchoice

choice FEATURE_COMPONENT_GPIO33_FUNCTION
    prompt "GPIO 33 Function (+ADC)"
    default FEATURE_COMPONENT_GPIO33_UNUSED

config FEATURE_COMPONENT_GPIO33_UNUSED
    bool "Unused"

config FEATURE_COMPONENT_GPIO33_OUTPUT_ANALOG
    bool "PWM Output"

config FEATURE_COMPONENT_GPIO33_OUTPUT_BINARY
    bool "Binary Output"

config FEATURE_COMPONENT_GPIO33_INPUT_BINARY
    bool "Binary Input"

config FEATURE_COMPONENT_GPIO33_INPUT_ANALOG
    bool "Analog Input"

endchoice

choice FEATURE_COMPONENT_GPIO33_INPUT_BINARY_PULL
    prompt "GPIO 33 Binary Input Pull Mode"
    default FEATURE_COMPONENT_GPIO33_INPUT_BINARY_PULLUP
    depends on FEATURE_COMPONENT_GPIO33_INPUT_BINARY

config FEATURE_COMPONENT_GPIO33_INPUT_BINARY_PULLUP
    bool "Pull-up"

config FEATURE_COMPONENT_GPIO33_INPUT_BINARY_PULLDOWN
    bool "Pull-down"

config FEATURE_COMPONENT_GPIO33_INPUT_BINARY_FLOATING
    bool "Floating / no pull"

endchoice

choice FEATURE_COMPONENT_GPIO34_FUNCTION
    prompt "GPIO 34 Function (+ADC, input only without internal pull-up/down)"
    default FEATURE_COMPONENT_GPIO34_UNUSED

config FEATURE_COMPONENT_GPIO34_UNUSED
    bool "Unused"

config FEATURE_COMPONENT_GPIO34_INPUT_BINARY
    bool "Binary Input"

config FEATURE_COMPONENT_GPIO34_INPUT_ANALOG
    bool "Analog Input"

endchoice

endmenu

menu "Services"

config SERVICES_WIFIAP
    bool "Enable WiFi Access Point"
    default n

config SERVICES_WIFICLIENT
    bool "Enable WiFi client"
    default n

if SERVICES_WIFICLIENT

menu "WiFi Configuration"

config SERVICES_WIFICLIENT_SSID
    string "WiFi SSID"
    default "Ovolus"

config SERVICES_WIFICLIENT_PASSWORD
    string "WiFi Password"
    default "Bolzplatz.2025"

config SERVICES_WIFICLIENT_DNSSERVER
    string "DNS Server"
    default "192.168.178.65"

endmenu

endif

config SERVICES_SYSTIME
    bool "Enable system time service"
    default n

endmenu

endmenu
```

## sdkconfig.defaults
```kconfig
CONFIG_FEATURE_AUTOMATION_NONE=y
# CONFIG_FEATURE_AUTOMATION_TIME is not set
# CONFIG_FEATURE_AUTOMATION_EVENT is not set

CONFIG_FEATURE_INTERFACE_CLI=y
# CONFIG_FEATURE_INTERFACE_REST is not set
# CONFIG_FEATURE_INTERFACE_WEBUI is not set

CONFIG_FEATURE_DEVICE_LIGHT=y
CONFIG_LIGHT_COUNT=1
CONFIG_LIGHT_START_GPIO=2

CONFIG_FEATURE_DEVICE_RELAY=y
CONFIG_RELAY_COUNT=1
CONFIG_RELAY_START_GPIO=6

CONFIG_FEATURE_DEVICE_SENSOR=y
CONFIG_SENSOR_COUNT=1
CONFIG_SENSOR_START_GPIO=10

CONFIG_FEATURE_SECURITY_NONE=y
# CONFIG_FEATURE_SECURITY_AUTH is not set
```
